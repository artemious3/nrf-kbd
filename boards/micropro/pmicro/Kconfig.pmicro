## boards/micropro/pmicro/board.yml
```yaml
board:
  name: pmicro
  full_name: pmicro
  vendor: micropro
  socs:
    - name: nrf52840
```

## build/Kconfig/Kconfig.shield
```kconfig
osource "D:/WORK_NRF/test_kbd/test1/boards/shields/*/Kconfig.shield"
osource "D:/WORK_NRF/ncs/v3.3.0/nrf/boards/shields/*/Kconfig.shield"
```

## build/Kconfig/boards/Kconfig.defconfig
```kconfig
# Load Zephyr board defconfig descriptions.
osource "D:/WORK_NRF/test_kbd/test1/boards/micropro/pmicro/Kconfig.defconfig"
```

## build/test1/Kconfig/Kconfig.shield.defconfig
```kconfig
osource "D:/WORK_NRF/test_kbd/test1/boards/shields/*/Kconfig.defconfig"
osource "D:/WORK_NRF/ncs/v3.3.0/nrf/boards/shields/*/Kconfig.defconfig"
```

## build/test1/Kconfig/boards/Kconfig.pmicro
```kconfig
# Load board Kconfig descriptions.
osource "D:/WORK_NRF/test_kbd/test1/boards/micropro/pmicro/Kconfig.pmicro"
```
